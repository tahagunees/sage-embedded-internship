## projects/esp32-bldc-hil/sdkconfig.defaults
```kconfig
CONFIG_IDF_TARGET="esp32"
CONFIG_FREERTOS_HZ=1000
CONFIG_FREERTOS_SUPPORT_STATIC_ALLOCATION=y
# CONFIG_PM_ENABLE is not set
# CONFIG_SPIRAM is not set
# CONFIG_BT_ENABLED is not set
```

## projects/esp32-bldc-hil/test_app/sdkconfig.defaults
```kconfig
CONFIG_IDF_TARGET="esp32"
CONFIG_FREERTOS_HZ=1000
CONFIG_FREERTOS_SUPPORT_STATIC_ALLOCATION=y
# CONFIG_SPIRAM is not set
```
